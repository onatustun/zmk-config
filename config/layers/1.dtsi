layer_1 {
	label = "1";
    bindings = <
&kp GRAVE  &kp APOS  &none   &none   &none     &none   &kp MINUS  &kp EQUAL  &kp LBKT  &kp RBKT
&kp N1     &kp N2    &kp N3  &kp N4  &kp N5    &kp N6  &kp N7     &kp N8     &kp N9    &kp N0
&kp BSLH   &none     &none   &none   &none     &none   &none      &trans     &trans    &trans
                             &trans  &trans    &trans  &trans
	>;
};
