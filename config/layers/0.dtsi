layer_0 {
	label = "0";
    bindings = <
&kp Q  &kp W  &kp E  &kp R  &kp T        &kp Y      &kp U  &kp I       &kp O     &kp P
&kp A  &kp S  &kp D  &kp F  &kp G        &kp H      &kp J  &kp K       &kp L     &kp SEMI
&kp Z  &kp X  &kp C  &kp V  &kp B        &kp N      &kp M  &commaqmrk  &dotless  &slashgreater
                     &mo 3  &kp LSHFT    &kp SPACE  &mo 2
	>;
};
