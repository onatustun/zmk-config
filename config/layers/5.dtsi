layer_5 {
	label = "5";
    bindings = <
&trans  &trans  &trans  &trans  &trans    &trans  &trans  &trans  &trans  &trans
&trans  &trans  &trans  &trans  &trans    &trans  &trans  &trans  &trans  &trans
&mo 5   &trans  &trans  &trans  &trans    &trans  &trans  &trans  &trans  &mo 6
                        &trans  &trans    &trans  &trans
	>;
};
